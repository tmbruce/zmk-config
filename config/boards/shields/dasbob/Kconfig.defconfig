## config/boards/shields/dasbob/Kconfig.defconfig
```kconfig
if SHIELD_DASBOB_LEFT

config ZMK_KEYBOARD_NAME
	default "Dasbob"

config ZMK_SPLIT_ROLE_CENTRAL
	default y

endif

if SHIELD_DASBOB_LEFT || SHIELD_DASBOB_RIGHT

config ZMK_SPLIT
	default y

endif
```

## config/boards/shields/dasbob/Kconfig.shield
```kconfig
config SHIELD_DASBOB_LEFT
	def_bool $(shields_list_contains,dasbob_left)

config SHIELD_DASBOB_RIGHT
	def_bool $(shields_list_contains,dasbob_right)
```
