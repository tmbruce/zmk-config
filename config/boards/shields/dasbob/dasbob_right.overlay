/*
 * Dasbob Right Half — nice!nano v2 clone, handwired
 *
 * Pinout assumed identical to left half (same wiring convention).
 * Col 0 = farthest from right controller = innermost right key (nearest center).
 *
 * If your right controller is on the opposite side from the left, or if
 * right-side keys appear mirrored in the keymap, reverse the col-gpios list:
 *   swap P1.13 ↔ P0.31 (and the two in between) so the column order flips.
 *
 * Thumb keys assumed in row 3, cols 0/1/2 (innermost three on right half).
 */

/ {
    chosen {
        zmk,kscan = &kscan0;
    };

    kscan0: kscan {
        compatible = "zmk,kscan-gpio-matrix";
        wakeup-source;
        diode-direction = "row2col";

        row-gpios
            = <&gpio0 6  GPIO_ACTIVE_HIGH>  /* Row 0 — top row    */
            , <&gpio0 8  GPIO_ACTIVE_HIGH>  /* Row 1 — middle row */
            , <&gpio0 17 GPIO_ACTIVE_HIGH>  /* Row 2 — bottom row */
            , <&gpio0 20 GPIO_ACTIVE_HIGH>  /* Row 3 — thumb row  */
            ;

        col-gpios
            = <&gpio0 31 (GPIO_ACTIVE_HIGH | GPIO_PULL_DOWN)>  /* Col 0 — innermost right */
            , <&gpio0 29 (GPIO_ACTIVE_HIGH | GPIO_PULL_DOWN)>  /* Col 1                   */
            , <&gpio0 2  (GPIO_ACTIVE_HIGH | GPIO_PULL_DOWN)>  /* Col 2                   */
            , <&gpio1 15 (GPIO_ACTIVE_HIGH | GPIO_PULL_DOWN)>  /* Col 3                   */
            , <&gpio1 13 (GPIO_ACTIVE_HIGH | GPIO_PULL_DOWN)>  /* Col 4 — outermost right */
            ;
    };
};
